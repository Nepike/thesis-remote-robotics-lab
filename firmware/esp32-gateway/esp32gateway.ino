/*
 * esp32gateway — прозрачный сетевой мост «TCP ↔ UART» для робота.
 *
 * Роль в системе.
 *   Это прошивка «тонкого устройства»: ESP32 не интерпретирует данные и не
 *   содержит никакой логики управления роботом. Его единственная задача —
 *   двунаправленно перекладывать поток байтов между TCP-соединением (по WiFi
 *   с центральным сервером лаборатории) и аппаратным UART, к которому подключён
 *   низкоуровневый контроллер робота (Arduino с клиентом rosserial).
 *
 *   С точки зрения сервера всё выглядит так, будто Arduino подключён к нему
 *   напрямую по последовательному кабелю.
 *
 *   Прошивка намеренно тривиальна и НЕ меняется при добавлении новых команд или
 *   типов устройств - она лишь передаёт байты.
 */

#include <WiFi.h>   // Стек WiFi для ESP32 (TCP/IP, режим станции)

// --- Параметры подключения к точке доступа WiFi ---
// TODO: вынести в конфигурацию
const char* ssid     = "Nepike";
const char* password = "123453119670";

// TCP-сервер слушает порт 2000 — к нему подключается socat со стороны сервера
// лаборатории (порт должен совпадать с полем "port" устройства в devices.json).
WiFiServer server(2000);

// Текущее клиентское соединение. Мост рассчитан на одного клиента одновременно:
// единственный клиент — это сервер лаборатории (socat).
WiFiClient client;

// --- Распиновка ---
#define RXD2 16        // UART2 RX (приём от Arduino)
#define TXD2 17        // UART2 TX (передача в Arduino)
#define LED_PIN 2      // Встроенный светодиод — индикация состояния

// --- Буфер для пакетной отправки в TCP ---
// Байты, пришедшие из UART, копятся здесь и отправляются в TCP пачками, а не
// по одному. Это снижает накладные расходы: вместо множества крошечных
// TCP-сегментов (заголовок ~40 байт на каждый) отправляется один пакет.
#define TCP_BUF_SIZE 64
uint8_t tcpBuffer[TCP_BUF_SIZE];   // сам буфер накопления
uint8_t tcpBufPos = 0;             // сколько байт уже накоплено (позиция записи)

void setup() {
  // Отладочная консоль по USB (логи подключения, IP-адрес). На обмен с роботом
  // не влияет — это отдельный последовательный порт (UART0).
  Serial.begin(115200);

  // Светодиод как индикатор: горит — WiFi подключён, мигает — идёт подключение.
  pinMode(LED_PIN, OUTPUT);
  digitalWrite(LED_PIN, LOW);

  // Отключаем энергосбережение WiFi. По умолчанию модем периодически «засыпает»,
  // что добавляет задержки и провоцирует обрывы — для прозрачного туннеля в
  // реальном времени это критично, поэтому держим радио всегда активным.
  WiFi.setSleep(false);
  WiFi.begin(ssid, password);

  // Ждём установления соединения с точкой доступа, мигая светодиодом.
  Serial.print("Connecting to WiFi");
  while (WiFi.status() != WL_CONNECTED) {
    delay(500);
    Serial.print(".");
    digitalWrite(LED_PIN, !digitalRead(LED_PIN));
  }

  // Подключились — выводим полученный IP (его указывают в devices.json как "ip").
  Serial.println("\nConnected!");
  Serial.print("ESP32 IP: ");
  Serial.println(WiFi.localIP());
  digitalWrite(LED_PIN, HIGH);


  server.begin();

  // Инициализируем UART2 для связи с Arduino.
  // 57600 бод, 8 бит данных, без чётности, 1 стоп-бит (8N1).
  // ВАЖНО: скорость должна совпадать со скоростью низкоуровневого контроллера
  // (и параметром baud у rosserial на сервере), иначе обмен рассинхронизируется.
  Serial2.begin(57600, SERIAL_8N1, RXD2, TXD2);
}

void loop() {
  // Если активного клиента нет (ещё не подключился или соединение разорвано) —
  // пытаемся принять новое входящее соединение.
  if (!client || !client.connected()) {
    WiFiClient newClient = server.available();
    if (newClient) {
      client = newClient;
      // Отключаем алгоритм Нейгла (TCP_NODELAY): мелкие пакеты отправляются
      // немедленно, без ожидания накопления. Для управления в реальном времени
      // важнее низкая задержка, чем эффективность канала.
      client.setNoDelay(true);
      Serial.println("Client connected");

      // Сбрасываем «хвосты» от предыдущей сессии, чтобы новая началась с чистого
      // листа: опустошаем приёмный буфер UART, приёмный буфер TCP и обнуляем
      // буфер накопления. Иначе устаревшие байты могли бы сбить кадрирование
      // протокола rosserial.
      while (Serial2.available()) Serial2.read();
      while (client.available()) client.read();
      tcpBufPos = 0;
    }
    yield();   // отдаём управление планировщику/служебным задачам ESP32
    return;    // пока клиента нет — пересылать нечего, выходим из итерации
  }

  // Пока в TCP есть данные И в передающем буфере UART есть место — пересылаем
  // байт за байтом. Проверка availableForWrite() не даёт заблокироваться, если
  // UART не успевает отправлять (Arduino медленнее, чем сеть).
  while (client.available() && Serial2.availableForWrite() > 0) {
    Serial2.write(client.read());
  }

  // Считываем доступные байты из UART в буфер накопления.
  while (Serial2.available()) {
    if (!client.connected()) break;   // клиент отвалился — прекращаем чтение

    uint8_t c = Serial2.read();
    tcpBuffer[tcpBufPos++] = c;

    // Буфер заполнился — отправляем пачку в TCP и освобождаем его.
    if (tcpBufPos >= TCP_BUF_SIZE) {
      flushTcpBuffer();
    }
  }

  // Если в буфере остались байты, но больше ничего не приходит ни из TCP, ни из
  // UART, — отправляем их немедленно, не дожидаясь заполнения буфера. Это
  // ограничивает задержку: короткие сообщения не «зависают» в ожидании ещё
  // данных.
  if (tcpBufPos > 0 && !client.available() && !Serial2.available()) {
    flushTcpBuffer();
  }

  yield();   // обязательная уступка: даём ESP32 обслужить WiFi-стек и watchdog
}


// Отправка накопленного буфера в TCP-соединение.
void flushTcpBuffer() {
  if (tcpBufPos > 0 && client.connected()) {
    client.write(tcpBuffer, tcpBufPos);   // отправляем накопленные байты пачкой
    client.flush();                       // гарантируем отправку (проталкиваем из буфера сокета)
    tcpBufPos = 0;                        // буфер опустошён — начинаем накопление заново
  }
}
